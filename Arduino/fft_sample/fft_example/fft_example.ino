/*
  Example of use of the FFT libray
        Copyright (C) 2014 Enrique Condes
  This program is free software: you can redistribute it and/or modify
  it under the terms of the GNU General Public License as published by
  the Free Software Foundation, either version 3 of the License, or
  (at your option) any later version.
  This program is distributed in the hope that it will be useful,
  but WITHOUT ANY WARRANTY; without even the implied warranty of
  MERCHANTABILITY or FITNESS FOR A PARTICULAR PURPOSE.  See the
  GNU General Public License for more details.
  You should have received a copy of the GNU General Public License
  along with this program.  If not, see <http://www.gnu.org/licenses/>.
*/

/*
  In this example, the Arduino simulates the sampling of a sinusoidal 1000 Hz
  signal with an amplitude of 100, sampled at 5000 Hz. Samples are stored
  inside the vReal array. The samples are windowed according to Hamming
  function. The FFT is computed using the windowed samples. Then the magnitudes
  of each of the frequencies that compose the signal are calculated. Finally,
  the frequency with the highest peak is obtained, being that the main frequency
  present in the signal.
*/

#include "arduinoFFT.h"

arduinoFFT FFT = arduinoFFT(); /* Create FFT object */
/*
These values can be changed in order to evaluate the functions
*/
const uint16_t samples = 4096; //This value MUST ALWAYS be a power of 2
const double signalFrequency = 1;
const double samplingFrequency = 666666;
const uint8_t amplitude = 100;
/*
These are the input and output vectors
Input vectors receive computed results from FFT
*/
double vReal[samples]={-0.053,-0.057,-0.059,-0.063,-0.065,-0.066,-0.067,-0.067,-0.067,-0.066,-0.065,-0.062,-0.058,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-0.015,-0.006};
double vImag[samples];

#define SCL_INDEX 0x00
#define SCL_TIME 0x01
#define SCL_FREQUENCY 0x02
#define SCL_PLOT 0x03

// variable for feature extraction
double stad=0.0;
double skew = 0.0;
double kurt = 0.0;
double mue = 0.0;
double x;
double max_fft=0;
int max_fft_id=0;
int upper_band=0;
int under_band=0;  
int upper_band_2=0;
int under_band_2=0; 

void setup()
{
  Serial.begin(115200);
  Serial.println("Ready");
}

void loop()
{
  /* Build raw data */
  double cycles = (((samples-1) * signalFrequency) / samplingFrequency); //Number of signal cycles that the sampling will read
  for (uint16_t i = 0; i < samples; i++)
  {
    //vReal[i] = int8_t((amplitude * (sin((i * (twoPi * cycles)) / samples))) / 2.0);/* Build data with positive and negative values*/
    //vReal[i] = uint8_t((amplitude * (sin((i * (twoPi * cycles)) / samples) + 1.0)) / 2.0);/* Build data displaced on the Y axis to include only positive values*/
    vImag[i] = 0.0; //Imaginary part must be zeroed in case of looping to avoid wrong calculations and overflows
  }
  /* Print the results of the simulated sampling according to time */
  FFT.Compute(vReal, vImag,  samples, SCL_INDEX); /* Compute FFT */
  FFT.ComplexToMagnitude(vReal, vImag, samples);
  Serial.println("Computed Real values:");
  PrintVector(vReal, samples, SCL_INDEX);
  
 
  x = FFT.MajorPeak(vReal, samples, samplingFrequency);
  Serial.println(x, 6);
  
  while(1); /* Run Once */
  // delay(2000); /* Repeat after delay */

  /*calculation of the maximum of the signal and the position of the maximum
    Standardabweichung. wölbung, schiefe, bandbreite und mittenfrequenz1  1 1^
  */

  
}

void PrintVector(double *vData, uint16_t bufferSize, uint8_t scaleType)
{
  for (uint16_t i = 0; i < bufferSize; i++)
  {
    double abscissa;
    /* Print abscissa value */
    switch (scaleType)
    {
      case SCL_INDEX:
        abscissa = (i * 1.0);
  break;
      case SCL_TIME:
        abscissa = ((i * 1.0) / samplingFrequency);
  break;
      case SCL_FREQUENCY:
        abscissa = ((i * 1.0 * samplingFrequency) / samples);
  break;
    }
    Serial.print(abscissa, 6);
    if(scaleType==SCL_FREQUENCY)
      Serial.print("Hz");
    Serial.print(" ");
    Serial.println(vData[i], 4);
  }
  Serial.println();
  feat_extr();
}

void feat_extr(){
  // clean variables
   stad=0.0;
   skew = 0.0;
   kurt = 0.0;
   mue = 0.0;
   
  //calculate averrage value of the FFT
   for(int i =0; i<samples; i++){
    mue = mue + abs(vReal[i]); 
    
   }
   mue = mue/samples;

   //calculate stad
   for(int i =0; i<samples; i++){
    stad = (abs(vReal[i])-mue)*(abs(vReal[i])-mue)+stad;   
   }
   stad = sqrt(stad/samples);
   

   
    //calculate skew
   for(int i =0; i<samples; i++){
    skew = (abs(vReal[i])-mue)*(abs(vReal[i])-mue)*(abs(vReal[i])-mue)/stad+skew;   
   }
   skew = skew/samples;

   //calculate kurtolios
   for(int i =0; i<samples; i++){
    kurt = (abs(vReal[i])-mue)*(abs(vReal[i])-mue)*(abs(vReal[i])-mue)*(abs(vReal[i])-mue)/stad+skew;              
   }
   kurt = kurt/samples;
   
    //centerfrequency
    x = FFT.MajorPeak(vReal, samples, samplingFrequency);

    Serial.println(mue, 6);Serial.println(stad,6); Serial.println(skew,6);  Serial.println(kurt,6);

   //calculate bandwith and center frequency
   for(int i =0; i<samples; i++){
    if(vReal[i]>max_fft){
      max_fft=vReal[i];
      max_fft_id=i;
     
    }
    
   }
   for(int j =max_fft_id; j<samples; j++){
    
     if(vReal[j] <max_fft/2)
      upper_band = j;
      if(vReal[j] <max_fft/3){
        upper_band_2 = j;
        break;
     }
   }
     for(int h =max_fft_id; h>1; h--){
     
      if(vReal[h] <max_fft/2)
      under_band =h;
      if(vReal[h] <max_fft/3){
        under_band_2 = h;
        break;
     
    }
   }
 
   Serial.println("bandbreite für berechnung");Serial.println(upper_band_2,6);Serial.println(under_band_2,6);Serial.println(max_fft, 6);Serial.println(max_fft_id,6);
   Serial.println("Bandwith and center");

   Serial.println(max_fft, 6);Serial.println(max_fft_id,6); Serial.println(upper_band,6);  Serial.println(under_band,6);
   }


   
   
   

  
